// Nokia 5110 - Connections to FRDM KL25Z
// ---------------
// Reset           (RST, pin 1) connected to PTC8  -  GPIO (Output)
// SPI0_PCS0       (CE,  pin 2) connected to PTC4  -  SPI SS 
// Data/Command    (DC,  pin 3) connected to PTC7  -  GPIO (Output)
// SPI0_MOSI       (Din, pin 4) connected to PTC6  -  SPI MOSI
// SPI0_SCLK       (Clk, pin 5) connected to PTC5  -  SPI Clock
// 3.3V          (Vcc, pin 6) power
// back light    (BL,  pin 7) connect to 3.3V for backlight
// Ground        (Gnd, pin 8) ground

#include <stdint.h>
#include <stdio.h>

#include "stdbool.h"
#include "MKL25Z4.h"

#define SCREENW     84
#define SCREENH     48
#define MAX_X        84
#define MAX_Y        48
#define CONTRAST   0xB8

char Screen[SCREENW*SCREENH/8];//buffer stores the next image to be printed on the screen

// This table contains the hex values that represent pixels
// for a font that is 5 pixels wide and 8 pixels high

static const char ASCII[][5] = {
   {0x00, 0x00, 0x00, 0x00, 0x00} // 20
  ,{0x00, 0x00, 0x5f, 0x00, 0x00} // 21 !
  ,{0x00, 0x07, 0x00, 0x07, 0x00} // 22 "
  ,{0x14, 0x7f, 0x14, 0x7f, 0x14} // 23 #
  ,{0x24, 0x2a, 0x7f, 0x2a, 0x12} // 24 $
  ,{0x23, 0x13, 0x08, 0x64, 0x62} // 25 %
  ,{0x36, 0x49, 0x55, 0x22, 0x50} // 26 &
  ,{0x00, 0x05, 0x03, 0x00, 0x00} // 27 '
  ,{0x00, 0x1c, 0x22, 0x41, 0x00} // 28 (
  ,{0x00, 0x41, 0x22, 0x1c, 0x00} // 29 )
  ,{0x14, 0x08, 0x3e, 0x08, 0x14} // 2a *
  ,{0x08, 0x08, 0x3e, 0x08, 0x08} // 2b +
  ,{0x00, 0x50, 0x30, 0x00, 0x00} // 2c ,
  ,{0x08, 0x08, 0x08, 0x08, 0x08} // 2d -
  ,{0x00, 0x60, 0x60, 0x00, 0x00} // 2e .
  ,{0x20, 0x10, 0x08, 0x04, 0x02} // 2f /
  ,{0x3e, 0x51, 0x49, 0x45, 0x3e} // 30 0
  ,{0x00, 0x42, 0x7f, 0x40, 0x00} // 31 1
  ,{0x42, 0x61, 0x51, 0x49, 0x46} // 32 2
  ,{0x21, 0x41, 0x45, 0x4b, 0x31} // 33 3
  ,{0x18, 0x14, 0x12, 0x7f, 0x10} // 34 4
  ,{0x27, 0x45, 0x45, 0x45, 0x39} // 35 5
  ,{0x3c, 0x4a, 0x49, 0x49, 0x30} // 36 6
  ,{0x01, 0x71, 0x09, 0x05, 0x03} // 37 7
  ,{0x36, 0x49, 0x49, 0x49, 0x36} // 38 8
  ,{0x06, 0x49, 0x49, 0x29, 0x1e} // 39 9
  ,{0x00, 0x36, 0x36, 0x00, 0x00} // 3a :
  ,{0x00, 0x56, 0x36, 0x00, 0x00} // 3b ;
  ,{0x08, 0x14, 0x22, 0x41, 0x00} // 3c <
  ,{0x14, 0x14, 0x14, 0x14, 0x14} // 3d =
  ,{0x00, 0x41, 0x22, 0x14, 0x08} // 3e >
  ,{0x02, 0x01, 0x51, 0x09, 0x06} // 3f ?
  ,{0x32, 0x49, 0x79, 0x41, 0x3e} // 40 @
  ,{0x7e, 0x11, 0x11, 0x11, 0x7e} // 41 A
  ,{0x7f, 0x49, 0x49, 0x49, 0x36} // 42 B
  ,{0x3e, 0x41, 0x41, 0x41, 0x22} // 43 C
  ,{0x7f, 0x41, 0x41, 0x22, 0x1c} // 44 D
  ,{0x7f, 0x49, 0x49, 0x49, 0x41} // 45 E
  ,{0x7f, 0x09, 0x09, 0x09, 0x01} // 46 F
  ,{0x3e, 0x41, 0x49, 0x49, 0x7a} // 47 G
  ,{0x7f, 0x08, 0x08, 0x08, 0x7f} // 48 H
  ,{0x00, 0x41, 0x7f, 0x41, 0x00} // 49 I
  ,{0x20, 0x40, 0x41, 0x3f, 0x01} // 4a J
  ,{0x7f, 0x08, 0x14, 0x22, 0x41} // 4b K
  ,{0x7f, 0x40, 0x40, 0x40, 0x40} // 4c L
  ,{0x7f, 0x02, 0x0c, 0x02, 0x7f} // 4d M
  ,{0x7f, 0x04, 0x08, 0x10, 0x7f} // 4e N
  ,{0x3e, 0x41, 0x41, 0x41, 0x3e} // 4f O
  ,{0x7f, 0x09, 0x09, 0x09, 0x06} // 50 P
  ,{0x3e, 0x41, 0x51, 0x21, 0x5e} // 51 Q
  ,{0x7f, 0x09, 0x19, 0x29, 0x46} // 52 R
  ,{0x46, 0x49, 0x49, 0x49, 0x31} // 53 S
  ,{0x01, 0x01, 0x7f, 0x01, 0x01} // 54 T
  ,{0x3f, 0x40, 0x40, 0x40, 0x3f} // 55 U
  ,{0x1f, 0x20, 0x40, 0x20, 0x1f} // 56 V
  ,{0x3f, 0x40, 0x38, 0x40, 0x3f} // 57 W
  ,{0x63, 0x14, 0x08, 0x14, 0x63} // 58 X
  ,{0x07, 0x08, 0x70, 0x08, 0x07} // 59 Y
  ,{0x61, 0x51, 0x49, 0x45, 0x43} // 5a Z
  ,{0x00, 0x7f, 0x41, 0x41, 0x00} // 5b [
  ,{0x02, 0x04, 0x08, 0x10, 0x20} // 5c '\'
  ,{0x00, 0x41, 0x41, 0x7f, 0x00} // 5d ]
  ,{0x04, 0x02, 0x01, 0x02, 0x04} // 5e ^
  ,{0x40, 0x40, 0x40, 0x40, 0x40} // 5f _
  ,{0x00, 0x01, 0x02, 0x04, 0x00} // 60 `
  ,{0x20, 0x54, 0x54, 0x54, 0x78} // 61 a
  ,{0x7f, 0x48, 0x44, 0x44, 0x38} // 62 b
  ,{0x38, 0x44, 0x44, 0x44, 0x20} // 63 c
  ,{0x38, 0x44, 0x44, 0x48, 0x7f} // 64 d
  ,{0x38, 0x54, 0x54, 0x54, 0x18} // 65 e
  ,{0x08, 0x7e, 0x09, 0x01, 0x02} // 66 f
  ,{0x0c, 0x52, 0x52, 0x52, 0x3e} // 67 g
  ,{0x7f, 0x08, 0x04, 0x04, 0x78} // 68 h
  ,{0x00, 0x44, 0x7d, 0x40, 0x00} // 69 i
  ,{0x20, 0x40, 0x44, 0x3d, 0x00} // 6a j
  ,{0x7f, 0x10, 0x28, 0x44, 0x00} // 6b k
  ,{0x00, 0x41, 0x7f, 0x40, 0x00} // 6c l
  ,{0x7c, 0x04, 0x18, 0x04, 0x78} // 6d m
  ,{0x7c, 0x08, 0x04, 0x04, 0x78} // 6e n
  ,{0x38, 0x44, 0x44, 0x44, 0x38} // 6f o
  ,{0x7c, 0x14, 0x14, 0x14, 0x08} // 70 p
  ,{0x08, 0x14, 0x14, 0x18, 0x7c} // 71 q
  ,{0x7c, 0x08, 0x04, 0x04, 0x08} // 72 r
  ,{0x48, 0x54, 0x54, 0x54, 0x20} // 73 s
  ,{0x04, 0x3f, 0x44, 0x40, 0x20} // 74 t
  ,{0x3c, 0x40, 0x40, 0x20, 0x7c} // 75 u
  ,{0x1c, 0x20, 0x40, 0x20, 0x1c} // 76 v
  ,{0x3c, 0x40, 0x30, 0x40, 0x3c} // 77 w
  ,{0x44, 0x28, 0x10, 0x28, 0x44} // 78 x
  ,{0x0c, 0x50, 0x50, 0x50, 0x3c} // 79 y
  ,{0x44, 0x64, 0x54, 0x4c, 0x44} // 7a z
  ,{0x00, 0x08, 0x36, 0x41, 0x00} // 7b {
  ,{0x00, 0x00, 0x7f, 0x00, 0x00} // 7c |
  ,{0x00, 0x41, 0x36, 0x08, 0x00} // 7d }
  ,{0x10, 0x08, 0x08, 0x10, 0x08} // 7e ~
};

enum typeOfWrite
{
  COMMAND, // the transmission is an LCD command (val=0)
  DATA     // the transmission is data (val=1)
};

const unsigned char directions[] ={
  0x42, 0x4D, 0xB6, 0x08, 0x00, 0x00, 0x00, 0x00, 0x00, 0x00, 0x76, 0x00, 0x00, 0x00, 0x28, 0x00, 0x00, 0x00, 0x54, 0x00, 0x00, 0x00, 0x30, 0x00, 0x00, 0x00, 0x01, 0x00, 0x04, 0x00, 0x00, 0x00,
 0x00, 0x00, 0x40, 0x08, 0x00, 0x00, 0x00, 0x00, 0x00, 0x00, 0x00, 0x00, 0x00, 0x00, 0x00, 0x00, 0x00, 0x00, 0x00, 0x00, 0x00, 0x00, 0x00, 0x00, 0x00, 0x00, 0x00, 0x00, 0x80, 0x00, 0x00, 0x80,
 0x00, 0x00, 0x00, 0x80, 0x80, 0x00, 0x80, 0x00, 0x00, 0x00, 0x80, 0x00, 0x80, 0x00, 0x80, 0x80, 0x00, 0x00, 0x80, 0x80, 0x80, 0x00, 0xC0, 0xC0, 0xC0, 0x00, 0x00, 0x00, 0xFF, 0x00, 0x00, 0xFF,
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 0x0F, 0x00, 0x00, 0x00, 0x00, 0x00, 0x00, 0x00, 0x00, 0x00, 0x00, 0x00, 0x00, 0x00, 0x00, 0x00, 0x00, 0x00, 0x00, 0x00, 0x00, 0x00, 0xFF
};

void static lcdwrite(enum typeOfWrite type, char message);

void Nokia5110_OutChar(unsigned char data);
void Nokia5110_OutString(char *ptr);
void Nokia5110_OutUDec(unsigned short n);
void Nokia5110_SetCursor(unsigned char newX, unsigned char newY);
void Nokia5110_Clear(void);
void Nokia5110_DrawFullImage(const char *ptr);
void Nokia5110_PrintBMP(unsigned char xpos, unsigned char ypos, const unsigned char *ptr, unsigned char threshold);
void Nokia5110_ClearBuffer(void);
void Nokia5110_SetPixel(unsigned char x, unsigned char y);
void Nokia5110_ClearPixel(unsigned char x, unsigned char y) ;
void Nokia5110_DisplayBuffer(void);
void Draw(void);


int Main()
{
	volatile unsigned long delay;
  SIM->SCGC4 |= (1 << 22);//activate SSI0
  SIM->SCGC5 |= (1 <<  11);//activate Port C
	
  PORTC->PCR[7] |= (1 << 8);//configure PTC7(DC) as GPIO(ALT1) 
  PORTC->PCR[8] |= (1 << 8);//configure PTC8(RST) as GPIO(ALT1)
  GPIOC->PDDR |= (1 << 7)|(1 << 8);//set PTC7(DC),PTC8(RST) as output pins 
  
  PORTC->PCR[4] |= (0x2 << 8);//configure PTC4 as SPI SS(ALT2) 
  PORTC->PCR[5] |= (0x2 << 8);//configure PTC5 as SPI Clock(ALT2)
  PORTC->PCR[6] |= (0x2 << 8);//configure PTC6 as SPI MOSI(ALT2)
  
  SPI0->C1 &= ~(1 << 6);//disable SSI 
  SPI0->C1 |= (1 << 4);//master mode
  SPI0->C1 &= ~(1 << 0);//SPI serial data transfers start with MSB
  SPI0->C1 &= ~(1 << 3);//CPOL=0
  SPI0->C1 &= ~(1 << 2);//CPHA=0
  /*
  SSOE, MODFEN=1 --> SS pin (of Master) used as Slave Select Output
  */
  SPI0->C1 |= (1 << 1);//SSOE=1
  SPI0->C2 |= (1 << 4);//MODFEN=1
  /*
  BRD = (SPPR + 1) * 2^(SPR + 1)
  SPPR=0
  SPR=2
  BRD = 1 * 2^3 = 8
  Baud Rate = Bus Clock Freq./BRD = 24 MHz (default)/8 = 3 MHz
  */
  SPI0->BR &= ~(0x7 << 4);//SPPR=0
  SPI0->BR |= (0x2 << 0);//SPR=2
  SPI0->C1 |= (1 << 6);//enable SSI

  GPIOC->PDOR &= ~(1 << 8);// hold RST(PTC8) pin LOW
  for(delay=0; delay<5; delay++);// delay minimum 100 ns
  GPIOC->PDOR |= (1 << 8);// set RST(PTC8) pin HIGH

  lcdwrite(COMMAND, 0x21);              // chip active(PD=0); horizontal addressing mode(V = 0); use extended instruction set(H = 1)
  lcdwrite(COMMAND, 0x90);
  lcdwrite(COMMAND, CONTRAST);          // try 0xB8
  lcdwrite(COMMAND, 0x04);              // set temp coefficient
  lcdwrite(COMMAND, 0x14);              // LCD bias mode 1:48: try 0x13 or 0x14
  lcdwrite(COMMAND, 0x20);              // we must send 0x20 before modifying the display control mode
  lcdwrite(COMMAND, 0x0C);              // set display control to normal mode(D=1, E=0)
	while(1)
	{
		Draw();
	}
	return 0;
}
void static lcdwrite(enum typeOfWrite type, char message)
{
  if(type == COMMAND)
  {
    //wait until SSI0 not busy/transmit FIFO empty
	while((SPI0->S & (1 << 5)) != (1 << 5));
	GPIOC->PDOR &= ~(1 << 7);//PTC7(DC) => DC = 0, sending command
    SPI0->D = message;//command out
    //wait until SSI0 not busy/transmit FIFO empty. FIFO not be used when sending commands. The FIFOs are not used when writing
	//commands, and they are used when writing data.  This
	//ensures that the Data/Command pin status matches the byte
	//that is actually being transmitted.
    while((SPI0->S & (1 << 5)) != (1 << 5));
  } 
  else if(type == DATA)
  {
    while((SPI0->S & (1 << 5)) != (1 << 5));//The S register must be read with SPTEF(5th bit in S register) set to 1 before writing data to the D
	//register; otherwise, the D write is ignored.
	GPIOC->PDOR |= (1 << 7);//PTC7(DC) => DC = 0, sending data
    SPI0->D = message;//data out
  }
}

void Nokia5110_init(void)
{
  
}

void Nokia5110_OutChar(unsigned char data)
{
  int i;
  lcdwrite(DATA, 0x00);                 // blank vertical line padding
  for(i=0; i<5; i=i+1)
  {
    lcdwrite(DATA, ASCII[data - 0x20][i]);
  }
  lcdwrite(DATA, 0x00);                 // blank vertical line padding
}

void Nokia5110_OutString(char *ptr){
  while(*ptr)
  {
    Nokia5110_OutChar((unsigned char)*ptr);
    ptr = ptr + 1;
  }
}

void Nokia5110_OutUDec(unsigned short n)
{
  if(n < 10)
  {
    Nokia5110_OutString("    ");
    Nokia5110_OutChar(n+'0'); /* n is between 0 and 9 */
  } 
  else if(n<100)
  {
    Nokia5110_OutString("   ");
    Nokia5110_OutChar(n/10+'0'); /* tens digit */
    Nokia5110_OutChar(n%10+'0'); /* ones digit */
  } 
  else if(n<1000)
  {
    Nokia5110_OutString("  ");
    Nokia5110_OutChar(n/100+'0'); /* hundreds digit */
    n = n%100;
    Nokia5110_OutChar(n/10+'0'); /* tens digit */
    Nokia5110_OutChar(n%10+'0'); /* ones digit */
  }
  else if(n<10000)
  {
    Nokia5110_OutChar(' ');
    Nokia5110_OutChar(n/1000+'0'); /* thousands digit */
    n = n%1000;
    Nokia5110_OutChar(n/100+'0'); /* hundreds digit */
    n = n%100;
    Nokia5110_OutChar(n/10+'0'); /* tens digit */
    Nokia5110_OutChar(n%10+'0'); /* ones digit */
  }
  else 
  {
    Nokia5110_OutChar(n/10000+'0'); /* ten-thousands digit */
    n = n%10000;
    Nokia5110_OutChar(n/1000+'0'); /* thousands digit */
    n = n%1000;
    Nokia5110_OutChar(n/100+'0'); /* hundreds digit */
    n = n%100;
    Nokia5110_OutChar(n/10+'0'); /* tens digit */
    Nokia5110_OutChar(n%10+'0'); /* ones digit */
  }
}

void Nokia5110_SetCursor(unsigned char newX, unsigned char newY){
  if((newX > 11) || (newY > 5))//bad input
  {        
    return;// do nothing
  }
  //multiply newX by 7 because each character is 7 columns wide
  lcdwrite(COMMAND, 0x80|(newX*7));     //setting bit 7 updates X-position
  lcdwrite(COMMAND, 0x40|newY);         //setting bit 6 updates Y-position
}

void Nokia5110_Clear(void)
{
  int i;
  for(i=0; i<(MAX_X*MAX_Y/8); i=i+1)
  {
    lcdwrite(DATA, 0x00);
  }
  Nokia5110_SetCursor(0, 0);
}

void Nokia5110_DrawFullImage(const char *ptr)
{
  int i;
  Nokia5110_SetCursor(0, 0);
  for(i=0; i<(MAX_X*MAX_Y/8); i=i+1)
  {
    lcdwrite(DATA, ptr[i]);
  }
}

void Nokia5110_PrintBMP(unsigned char xpos, unsigned char ypos, const unsigned char *ptr, unsigned char threshold)
{
  long width = ptr[18], height = ptr[22], i, j;
  unsigned short screenx, screeny;
  unsigned char mask;
  // check for clipping
  if((height <= 0) ||              //bitmap is unexpectedly encoded in top-to-bottom pixel order
     ((width%2) != 0) ||           //must be even number of columns
     ((xpos + width) > SCREENW) || //right side cut off
     (ypos < (height - 1)) ||      //top cut off
     (ypos > SCREENH))           { //bottom cut off
    return;
  }
  if(threshold > 14)
  {
    threshold = 14;             //only full 'on' turns pixel on
  }
  //bitmaps are encoded backwards, so start at the bottom left corner of the image
  screeny = ypos/8;
  screenx = xpos + SCREENW*screeny;
  mask = ypos%8;                //row 0 to 7
  mask = 0x01<<mask;            //now stores a mask 0x01 to 0x80
  j = ptr[10];                  //byte 10 contains the offset where image data can be found
  for(i=1; i<=(width*height/2); i=i+1)
  {
    //the left pixel is in the upper 4 bits
    if(((ptr[j]>>4)&0xF) > threshold)
	{
      Screen[screenx] |= mask;
    } 
	else
	{
      Screen[screenx] &= ~mask;
    }
    screenx = screenx + 1;
    //the right pixel is in the lower 4 bits
    if((ptr[j]&0xF) > threshold)
	{
      Screen[screenx] |= mask;
    } 
	else
	{
      Screen[screenx] &= ~mask;
    }
    screenx = screenx + 1;
    j = j + 1;
    if((i%(width/2)) == 0)//at the end of a row
	{     
      if(mask > 0x01)
	  {
        mask = mask>>1;
      } 
	  else
	  {
        mask = 0x80;
        screeny = screeny - 1;
      }
      screenx = xpos + SCREENW*screeny;
      //bitmaps are 32-bit word aligned
      switch((width/2)%4)//skip any padding
	  {      
        case 0: j = j + 0; break;
        case 1: j = j + 3; break;
        case 2: j = j + 2; break;
        case 3: j = j + 1; break;
      }
    }
  }
}

void Nokia5110_ClearBuffer(void)
{
  int i;
  for(i=0; i<SCREENW*SCREENH/8; i=i+1)
  {
    Screen[i] = 0;//clear buffer
  }
}

void Nokia5110_SetPixel(unsigned char x, unsigned char y) 
{
  unsigned short PixelByte;//byte# in screen buffer
  unsigned char PixelBit;//bit# in byte
  if ((x<84) && (y<48))//check screen boundaries
  {              
    PixelByte = ((y/8)*84) + x;
    PixelBit = y % 8;
    Screen[PixelByte] |= 1U<<PixelBit;
  }
}

void Nokia5110_ClearPixel(unsigned char x, unsigned char y) 
{
  unsigned short PixelByte;//byte# in screen buffer
  unsigned char PixelBit;//bit# in byte
  if ((x<84) && (y<48))//check screen boundaries
  {              
    PixelByte = ((y/8)*84) + x;
    PixelBit = y % 8;
    Screen[PixelByte] &= ~(1U<<PixelBit);
  }
}

void Nokia5110_DisplayBuffer(void)
{
  Nokia5110_DrawFullImage(Screen);
}

void Draw(void)
{ 
  Nokia5110_ClearBuffer();
  Nokia5110_PrintBMP(0, 47, directions, 0);	
  Nokia5110_DisplayBuffer();//draw buffer
}